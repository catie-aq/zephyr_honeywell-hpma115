## drivers/Kconfig
```kconfig
# Copyright (c) 2021 Nordic Semiconductor ASA
# SPDX-License-Identifier: Apache-2.0

menu "Device Drivers"

rsource "sensor/Kconfig"

endmenu
```

## drivers/sensor/Kconfig
```kconfig
# Copyright (c) 2021 Nordic Semiconductor ASA
# SPDX-License-Identifier: Apache-2.0

if SENSOR
rsource "hpma115/Kconfig"
endif # SENSOR
```

## drivers/sensor/honeywell-hpma115/Kconfig
```kconfig
# SPDX-License-Identifier: Apache-2.0

config HPMA115
	bool "HPMA115 peripheral"
	default y
	depends on UART_INTERRUPT_DRIVEN
	help
	  Enable hpma115 sensor
```

## drivers/sensor/honeywell/Kconfig
```kconfig
# Copyright (c) 2024 CATIE
# SPDX-License-Identifier: Apache-2.0

source "drivers/sensor/honeywell/hpma115/Kconfig"
```

## drivers/sensor/honeywell/hpma115/Kconfig
```kconfig
# SPDX-License-Identifier: Apache-2.0

config HPMA115
	bool "HPMA115 peripheral"
	default y
	depends on DT_HAS_HONEYWELL_HPMA115_ENABLED && UART_INTERRUPT_DRIVEN
	help
	  Enable hpma115 sensor
```
